## applications/hpf/mspi/sample.yaml
```yaml
sample:
  name: HPF ws2812 application
  description: HPF ws2812 application
common:
  integration_platforms:
    - nrf54l15dk/nrf54l15/cpuflpr
tests:
  applications.hpf.ws2812:
    build_only: true
    sysbuild: true
    platform_allow: nrf54l15dk/nrf54l15/cpuflpr
    tags:
      - ci_build
      - sysbuild
      - ws2812
      - ci_applications_hpf
```

## drivers/led_strip/Kconfig
```kconfig
# Copyright (c) 2025 Nordic Semiconductor ASA
# SPDX-License-Identifier: Apache-2.0

menuconfig LED_STRIP_NRF
	bool "LED strip drivers for Nordic devices"
	help
	  Enable LED strip drivers for Nordic semiconductor devices.

if LED_STRIP_NRF

rsource "Kconfig.ws2812_nrf54l15"

endif # LED_STRIP_NRF
```

## drivers/led_strip/Kconfig.ws2812_nrf54l15
```kconfig
# Copyright (c) 2025 Nordic Semiconductor ASA
# SPDX-License-Identifier: Apache-2.0

config WS2812_NRF54L15
	bool "WS2812 LED strip driver for nRF54L15"
	default y
	depends on DT_HAS_NORDIC_NRF54L15_WS2812_ENABLED
	depends on SOC_SERIES_NRF54LX
	depends on MBOX
	help
	  Enable WS2812 LED strip driver for nRF54L15 using the FLPR coprocessor
	  for deterministic timing. This driver provides hardware-accelerated
	  WS2812 control with precise timing requirements.
```
